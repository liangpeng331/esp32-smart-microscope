## firmware/boards/ESP32_P4_WAVESHARE_4B/sdkconfig.defaults
```kconfig
# ESP32-P4 MicroPython 固件 SDK 配置覆盖
# 基于 ESP-IDF v5.3+

# ---- ESP32-P4 目标 ----
CONFIG_IDF_TARGET_ESP32P4=y

# ---- CPU & 内存 ----
CONFIG_ESP32P4_DEFAULT_CPU_FREQ_400=y
CONFIG_ESP32P4_SPIRAM_SUPPORT=y
CONFIG_SPIRAM_MODE_OCT=y
CONFIG_SPIRAM_SPEED_80M=y
CONFIG_SPIRAM_USE_CAPS_ALLOC=y
CONFIG_SPIRAM_MALLOC_ALWAYSINTERNAL=4096
CONFIG_SPIRAM_ALLOW_BSS_SEG_EXTERNAL_MEMORY=y

# ---- Flash ----
CONFIG_ESPTOOLPY_FLASHSIZE_16MB=y
CONFIG_ESPTOOLPY_FLASHMODE_QIO=y
CONFIG_ESPTOOLPY_FLASHFREQ_80M=y

# ---- 主频 (400MHz) ----
CONFIG_ESP_DEFAULT_CPU_FREQ_MHZ_400=y

# ---- 摄像头 ----
CONFIG_ESP_CAMERA_ENABLE=y

# ---- SD 卡 (SDMMC 4-bit) ----
CONFIG_SDMMC_SUPPORT=y

# ---- FAT 文件系统 ----
CONFIG_FATFS_LFN=y
CONFIG_FATFS_MAX_LFN=255
CONFIG_FATFS_API_ENCODING_UTF_8=y
CONFIG_FATFS_CODEPAGE=936  # 简体中文

# ---- I2C (触摸 / 摄像头) ----
CONFIG_I2C_MASTER_ENABLE=y

# ---- SPI (LCD 可能使用) ----
CONFIG_SPI_MASTER_ENABLE=y

# ---- WiFi 协处理器 (ESP32-C6) ----
CONFIG_ESP_WIFI_REMOTE_SUPPORT=y

# ---- I2S (麦克风) ----
CONFIG_I2S_SUPPRESS_DEPRECATE_WARN=y

# ---- 蓝牙 — 禁用 ----
CONFIG_BT_ENABLED=n
CONFIG_BT_CONTROLLER_ENABLED=n

# ---- LVGL ----
CONFIG_LVGL_ENABLE=y
CONFIG_LVGL_COLOR_DEPTH=16
CONFIG_LVGL_COLOR_16_SWAP=n
CONFIG_LVGL_DISP_BUF_SIZE=720
CONFIG_LVGL_USE_PERF_MONITOR=n

# ---- GPIO ----
CONFIG_GPIO_CTRL_FUNC_IN_IRAM=y

# ---- FreeRTOS 任务栈 ----
CONFIG_ESP_MAIN_TASK_STACK_SIZE=8192
CONFIG_FREERTOS_TIMER_TASK_STACK_DEPTH=4096

# ---- 优化 ----
CONFIG_COMPILER_OPTIMIZATION_SIZE=y
CONFIG_COMPILER_OPTIMIZATION_ASSERTIONS_DISABLE=y

# ---- 分区表（使用自定义分区，6MB firmware + LVGL + FAT） ----
CONFIG_PARTITION_TABLE_CUSTOM=y
CONFIG_PARTITION_TABLE_CUSTOM_FILENAME="partitions.csv"

# ---- 控制台 ----
CONFIG_ESP_CONSOLE_UART_DEFAULT=y
CONFIG_ESP_CONSOLE_UART_NUM=0
CONFIG_ESP_CONSOLE_UART_BAUDRATE=115200
```
